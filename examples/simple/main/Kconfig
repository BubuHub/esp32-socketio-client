## examples/simple/main/Kconfig
```kconfig
menu "SocketIO"

    config EXAMPLE_SIO_URL
        string "SocketIO url"
        default "http://10.0.7.25:8010"
        help
            SocketIO url for the example to connect to.


endmenu
```

## examples/simple/sdkconfig.defaults
```kconfig
#
# ULP
#
CONFIG_ESP32_ULP_COPROC_ENABLED=y
CONFIG_ESP32_ULP_COPROC_RESERVE_MEM=512
#
# SPI FLASH
#
CONFIG_ESPTOOLPY_FLASHSIZE_4MB=y
CONFIG_PARTITION_TABLE_CUSTOM=y
CONFIG_PARTITION_TABLE_CUSTOM_FILENAME="partitions.csv"
CONFIG_PARTITION_TABLE_FILENAME="partitions.csv"
#
# FREETROS
#
#CONFIG_FREERTOS_USE_TRACE_FACILITY=y
CONFIG_FREERTOS_GENERATE_RUN_TIME_STATS=y
#
# CPU FREQ
#
CONFIG_ESP32_DEFAULT_CPU_FREQ_MHZ=80
CONFIG_ESP32_DEFAULT_CPU_FREQ_80=y
#
# RTC
#
CONFIG_RTCIO_SUPPORT_RTC_GPIO_DESC=y
CONFIG_ESP32_RTC_CLK_SRC_EXT_CRYS=y
CONFIG_ESP32_RTC_CLK_CAL_CYCLES=1024
#CONFIG_ESP32_TIME_SYSCALL_USE_RTC=y
#
# WIFI
#
#CONFIG_DEFAULT_AP_SSID="MLT4"
#CONFIG_DEFAULT_AP_PASSWORD="mlt4pwd"
CONFIG_ESP32_WIFI_NVS_ENABLED=n
#
#HTTP
#
CONFIG_HTTPD_MAX_REQ_HDR_LEN=8192
CONFIG_HTTPD_WS_SUPPORT=y
#
# DEBUG
#
#CONFIG_LOG_DEFAULT_LEVEL_NONE=y
#CONFIG_WIFI_LOG_DEFAULT_LEVEL_NONE=y
#CONFIG_LOG_DEFAULT_LEVEL_DEBUG=y
#
# Connection manager
#
CONFIG_AP_LANG_PL=y
#
# LWIP
#
CONFIG_LWIP_MAX_SOCKETS=16
CONFIG_LWIP_TCPIP_TASK_AFFINITY_CPU0=y
CONFIG_LWIP_DNS_SUPPORT_MDNS_QUERIES=y
CONFIG_MDNS_RESOLVE_TEST_SERVICES=y
CONFIG_MDNS_ADD_MAC_TO_HOSTNAME=y
#
# PM
#
CONFIG_ESP_WIFI_STA_DISCONNECTED_PM_ENABLE=y
CONFIG_PM_ENABLE=y
#CONFIG_PM_DFS_INIT_AUTO=y
CONFIG_PM_PROFILING=y
CONFIG_FREERTOS_USE_TICKLESS_IDLE=y
CONFIG_FREERTOS_ASSERT_FAIL_PRINT_CONTINUE=y
#
#
CONFIG_APP_PROJECT_VER_FROM_CONFIG=y
CONFIG_APP_PROJECT_VER="1.0.1"
CONFIG_COMPILER_OPTIMIZATION_PERF=y
#
# RAW power on CPU1
#
CONFIG_ESP_INT_WDT=n
CONFIG_ESP_TASK_WDT_CHECK_IDLE_TASK_CPU1=n
#CONFIG_FREERTOS_HZ=1000
#
# CXX
#
CONFIG_COMPILER_CXX_EXCEPTIONS=y
#CONFIG_COMPILER_CXX_RTTI=y

#
# wss
#
CONFIG_ESP_TLS_INSECURE=y
CONFIG_ESP_TLS_SKIP_SERVER_CERT_VERIFY=y


CONFIG_WIFI_MANAGER_RETRY_TIMER=20000

#
# Wifi configuration
#
CONFIG_EXAMPLE_CONNECT_WIFI=y
CONFIG_EXAMPLE_WIFI_SSID="MYSSID"
CONFIG_EXAMPLE_WIFI_PASSWORD="MYPASS"
CONFIG_EXAMPLE_SIO_URL="http://10.0.7.25:8010"
```
